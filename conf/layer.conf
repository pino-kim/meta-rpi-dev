## conf/layer.conf
```bitbake
# We have a conf and classes directory, add to BBPATH
BBPATH .= ":${LAYERDIR}"

# We have recipes-* directories, add to BBFILES
BBFILES += "${LAYERDIR}/recipes-*/*/*.bb \
            ${LAYERDIR}/recipes-*/*/*.bbappend"

BBFILE_COLLECTIONS += "meta-rpi-dev"
BBFILE_PATTERN_meta-rpi-dev = "^${LAYERDIR}/"
BBFILE_PRIORITY_meta-rpi-dev = "6"

LAYERDEPENDS_meta-rpi-dev = "core"
LAYERSERIES_COMPAT_meta-rpi-dev = "gatesgarth hardknott"
```
